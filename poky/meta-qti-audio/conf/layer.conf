## poky/meta-qti-audio/conf/layer.conf
```bitbake
BBFILES += "${LAYERDIR}/recipes/*/*.bb ${LAYERDIR}/recipes/*/*.bbappend ${LAYERDIR}/recipes-*/*/*.bb ${LAYERDIR}/recipes-*/*/*.bbappend"
BBPATH .= ":${LAYERDIR}"
BBFILE_COLLECTIONS += "audio"
LAYERSERIES_COMPAT_audio = "scarthgap walnascar"
BBFILE_PRIORITY_audio = "20"
BBFILE_PATTERN_audio := "^${LAYERDIR}/"
```

## poky/meta-qti-bt/conf/layer.conf
```bitbake
BBFILES += "${LAYERDIR}/recipes/*/*.bb ${LAYERDIR}/recipes/*/*.bbappend ${LAYERDIR}/recipes-*/*/*.bb ${LAYERDIR}/recipes-products/images/*.bbappend"
BBPATH .= ":${LAYERDIR}"
BBFILE_COLLECTIONS += "bt"
LAYERSERIES_COMPAT_bt = "scarthgap walnascar"
BBFILE_PRIORITY_bt = "12"
BBFILE_PATTERN_bt := "^${LAYERDIR}/"
```

## poky/meta-qti-drones/conf/layer.conf
```bitbake
BBFILES += "${LAYERDIR}/recipes/*/*.bb ${LAYERDIR}/recipes/*/*.bbappend ${LAYERDIR}/recipes-*/*/*.bb ${LAYERDIR}/recipes-products/images/*.bbappend"
BBPATH .= ":${LAYERDIR}"
BBFILE_COLLECTIONS += "msm-drones"
BBFILE_PRIORITY_msm-drones = "12"
BBFILE_PATTERN_msm-drones := "^${LAYERDIR}/"
LAYERSERIES_COMPAT_msm-drones = "kirkstone"
```

## poky/meta-qti-qsap/conf/layer.conf
```bitbake
BBFILES += "${LAYERDIR}/recipes/*/*.bb ${LAYERDIR}/recipes/*/*.bbappend ${LAYERDIR}/recipes-*/*/*.bb ${LAYERDIR}/recipes-*/*/*.bbappend"
BBPATH .= ":${LAYERDIR}"
BBFILE_COLLECTIONS += "qsap"
LAYERSERIES_COMPAT_qsap = "kirkstone"
BBFILE_PATTERN_qsap := "^${LAYERDIR}/"

# msm = meta-qti-bsp
LAYERDEPENDS:qsap = "msm"
```

## poky/meta-qti-ss-mgr/conf/layer.conf
```bitbake
BBFILES += "${LAYERDIR}/recipes/*/*.bb ${LAYERDIR}/recipes/*/*.bbappend ${LAYERDIR}/recipes-*/*/*.bb ${LAYERDIR}/recipes-products/images/*.bbappend"
BBPATH .= ":${LAYERDIR}"
BBFILE_COLLECTIONS += "msm-ss-mgr"
BBFILE_PRIORITY_msm-ss-mgr = "12"
BBFILE_PATTERN_msm-ss-mgr := "^${LAYERDIR}/"
LAYERSERIES_COMPAT_msm-ss-mgr = "kirkstone"
```

## poky/meta-qti-wlan/conf/layer.conf
```bitbake
BBFILES += "${LAYERDIR}/recipes/*/*.bb ${LAYERDIR}/recipes/*/*.bbappend ${LAYERDIR}/recipes-*/*/*.bb ${LAYERDIR}/recipes-products/images/*.bbappend"
BBPATH .= ":${LAYERDIR}"
BBFILE_COLLECTIONS += "wlan"
LAYERSERIES_COMPAT_wlan = "kirkstone"
BBFILE_PRIORITY_wlan = "12"
BBFILE_PATTERN_wlan := "^${LAYERDIR}/"
```
